/* USER CODE BEGIN 4 */
static bool Starting_Staining(void) // GEREKLI KONTROLLER SAGLANACAK,EGER HERSEY YERINDEYSE CIHAZ BOYAMA ISLEMINE BASLAMA TALIMATI ALACAK
{
    /*
     * BU KISIMA ARAYÜZDEN GELEN BASLA BİLGİSİNİ KONTROL ETME SARTI KONULACAK. (SONSUZ DÖNGÜ DE) . main.c NIN ICINE DE KONULABILIR. KONTROL EDECEGIZ.
     *
     */

	if(HAL_GPIO_ReadPin(RAKKONTROLIRSENSOR_GPIO_Port, RAKKONTROLIRSENSOR_Pin) == GPIO_PIN_RESET)  // RAK YERİNE KONDU MU ?
	{
		delay_ms(50);
		HAL_UART_Transmit_IT(&huart2, POPUP_MAKESURE_DRAWERS_ARE_CLOSED_ENGLISH, 6); // BURAYA RAKI YERLSTIRINIZ UYARISI VERILECEK GECICI OLARAK BU YAZILDI. AYRICA BURAYA PLAY BUTONUNA YENIDEN DONDERMEDE KOYULMASI GEREKIYOR.
		Baslama_Bitis_Kontrol = false; // BUNU TEKRAR FALSE YAPIP KULLANICIDAN DONUS BEKLEYECEGIZ.
		for(uint8_t k=0; k<15; k++)
		{
			BUFFER_FOR_RECEIVE[k] = 0;   // BUFFER I TEMIZLIYORUZ. CUNKU YENIDEN BASLAT BILGISI BEKLEYECEGIZ.
		}
		delay_ms(50);
		HAL_UART_Transmit_IT(&huart2, ICON_PLAY_BUTTON, 8);
		return false;  // KONMADIYSA FALSE DÖNDERİP ÇALI�?TIRMIYOR
	}

	else if(HAL_GPIO_ReadPin(RAKCEKMECELIMITSWITCH_GPIO_Port, RAKCEKMECELIMITSWITCH_Pin) == GPIO_PIN_RESET) // RAKCEKMECE LIMIT SWITCH NORMALDE SET SWITCH BASILINCA RESET OLACAK
	{
	//	delay_ms(50);
		HAL_UART_Transmit_IT(&huart2, POPUP_MAKESURE_DRAWERS_ARE_CLOSED_ENGLISH, 6); //  ABURAYA PLAY BUTONUNA YENIDEN DONDERMEDE KOYULMASI GEREKIYOR.
		Baslama_Bitis_Kontrol = false; // BUNU TEKRAR FALSE YAPIP KULLANICIDAN DONUS BEKLEYECEGIZ.
		for(uint8_t k=0; k<15; k++)
		{
			BUFFER_FOR_RECEIVE[k] = 0;   // BUFFER I TEMIZLIYORUZ. CUNKU YENIDEN BASLAT BILGISI BEKLEYECEGIZ.
		}
		delay_ms(50);
		HAL_UART_Transmit_IT(&huart2, ICON_PLAY_BUTTON, 8);
		return false;
	}

	else if(HAL_GPIO_ReadPin(SAGCEKMECELIMITSWITCH_GPIO_Port, SAGCEKMECELIMITSWITCH_Pin) == GPIO_PIN_RESET)  // SAGCEKMECE LIMIT SWITCH NORMALDE SET SWITCH BASILINCA RESET OLACAK
	{
	//	delay_ms(50);
		HAL_UART_Transmit_IT(&huart2, POPUP_MAKESURE_DRAWERS_ARE_CLOSED_ENGLISH, 6); //  BURAYA PLAY BUTONUNA YENIDEN DONDERMEDE KOYULMASI GEREKIYOR.
		Baslama_Bitis_Kontrol = false; // BUNU TEKRAR FALSE YAPIP KULLANICIDAN DONUS BEKLEYECEGIZ.
		for(uint8_t k=0; k<15; k++)
		{
			BUFFER_FOR_RECEIVE[k] = 0;   // BUFFER I TEMIZLIYORUZ. CUNKU YENIDEN BASLAT BILGISI BEKLEYECEGIZ.
		}
		delay_ms(30);
		HAL_UART_Transmit_IT(&huart2, ICON_PLAY_BUTTON, 8);
		return false;
	}

	else if(HAL_GPIO_ReadPin(SOLCEKMECELIMITSWITCH_GPIO_Port, SOLCEKMECELIMITSWITCH_Pin) == GPIO_PIN_RESET) // SOLCEKMECE LIMIT SWITCH NORMALDE SET SWITCH BASILINCA RESET OLACAK
	{
	//	delay_ms(50);
		HAL_UART_Transmit_IT(&huart2, POPUP_MAKESURE_DRAWERS_ARE_CLOSED_ENGLISH, 6); //  BURAYA PLAY BUTONUNA YENIDEN DONDERMEDE KOYULMASI GEREKIYOR.
		Baslama_Bitis_Kontrol = false; // BUNU TEKRAR FALSE YAPIP KULLANICIDAN DONUS BEKLEYECEGIZ.
		for(uint8_t k=0; k<15; k++)
		{
			BUFFER_FOR_RECEIVE[k] = 0;   // BUFFER I TEMIZLIYORUZ. CUNKU YENIDEN BASLAT BILGISI BEKLEYECEGIZ.
		}
		delay_ms(50);
		HAL_UART_Transmit_IT(&huart2, ICON_PLAY_BUTTON, 8);
		return false;
	}

	else if(HAL_GPIO_ReadPin(DISPLEKSILIMITSWITCH_GPIO_Port,DISPLEKSILIMITSWITCH_Pin) == GPIO_PIN_RESET) // DISPLEKSI LIMIT SWITCH NORMALDE SET SWITCH BASILINCA RESET OLACAK
	{
	//	delay_ms(50);
		HAL_UART_Transmit_IT(&huart2, POPUP_MAKESURE_DRAWERS_ARE_CLOSED_ENGLISH, 6); //  BURAYA PLAY BUTONUNA YENIDEN DONDERMEDE KOYULMASI GEREKIYOR.
		Baslama_Bitis_Kontrol = false; // BUNU TEKRAR FALSE YAPIP KULLANICIDAN DONUS BEKLEYECEGIZ.
		for(uint8_t k=0; k<15; k++)
		{
			BUFFER_FOR_RECEIVE[k] = 0;   // BUFFER I TEMIZLIYORUZ. CUNKU YENIDEN BASLAT BILGISI BEKLEYECEGIZ.
		}
		delay_ms(50);
		HAL_UART_Transmit_IT(&huart2, ICON_PLAY_BUTTON, 8);
		return false;
	}

	else
	{
		HAL_GPIO_WritePin(SAG_SOL_CEKMECE_ELEKTROMIKNATIS_IN1_GPIO_Port, SAG_SOL_CEKMECE_ELEKTROMIKNATIS_IN1_Pin, GPIO_PIN_SET); // SAG_SOL_CEKMECE_ELEKTROMIKNATIS LAR AKTIF (ILERDE YUKSEK IHTIMALLE DEGISECEK!!!)
		HAL_GPIO_WritePin(SAG_SOL_CEKMECE_ELEKTROMIKNATIS_IN2_GPIO_Port, SAG_SOL_CEKMECE_ELEKTROMIKNATIS_IN2_Pin, GPIO_PIN_RESET);
		delay_ms(50);
		HAL_GPIO_WritePin(RAK_ELEKTROMIKNATIS_AIN1_GPIO_Port, RAK_ELEKTROMIKNATIS_AIN1_Pin, GPIO_PIN_SET);  // RAK_ELEKTROMIKNATIS AKTIF  (ILERDE YUKSEK IHTIMALLE DEGISECEK!!!)
		HAL_GPIO_WritePin(RAK_ELEKTROMIKNATIS_AIN2_GPIO_Port, RAK_ELEKTROMIKNATIS_AIN2_Pin, GPIO_PIN_RESET);
		delay_ms(50);
	//	HAL_UART_Transmit(&huart2, ICON_LOCK_BUTTON, 9,100); //BUNU CALISTIRINCA YUZDE VE PROCESS CALISMIYOR. NEDEN OLDUGUNU COZMEYE CALISIYORUM FAKAT PROTOTIP ICIN ACIL DEGIL
		delay_ms(50);

		return true;
	}


	/*
	 * KÜVETLER YERİNDE Mİ SORUSUNU KAPASİTİF SENSÖR İLE; DİSTİLE SU DOLU MU ? ve ATIK SU BİDONU DOLDU MU ? SORULARINI
	 * EXTERNAL INTERRUPT İLE YAPACAGIZ.
	 * KAPAKLARI ACMA İSLEMİ UART RX INTERRUPT ÜZERİNDEN BAGLANARAK İSTENİLDİGİ ZAMAN İSLEM BASLAYABİLİR.
	 * YALNIZ KAPAK KAPAMA İSLEMLERİ LIMIT SWITCHLER UZERINDEN EXTERNAL INTERRUPT A BAGLANMALI. VE BU INTERRUPT I BİZİM KAPATINCA BİR KERE AKTİF ETMEMIZ LAZIM.
	 */
}

static void Staining_Process(uint8_t Process_Number)
{
	/*
	 * ON ISLEM : CIHAZIN KAPAKLARI KAPATILINCA ELEKTROMIKNATIS TUTACAK. BU OLAY  LIMIT SWITCHLER ILE YAPILABILIR. (BUNA FONKSIYON YAZILACAK.)
	 * 1. RAK'I ALMAYA GIDECEK VE ALACAK.
	 * 2. BIRINCI KUVETE GIDECEK KAPASITIF SENSOR KONTROL EDECEK(EGER KUVET YOKSA MOTORU DURDURUP ESKI YERINE DÖNECEK.) VE DALDIRACAK CIKARACAK VE BEKLEYECEK.
	 * 3. BURADA TIMER AYARLANARAK BİR MUDDET BEKLENECEK (SYSTICK TIMER KULLANABILIRIZ)
	 * 4. IKINCI KUVETE GIDECEK KAPASITIF SENSOR KONTROL EDECEK(EGER KUVET YOKSA MOTORU DURDURUP ESKI YERINE DÖNECEK.) VE DALDIRACAK CIKARACAK VE BEKLEYECEK.
	 * 5. BURADA TIMER AYARLANARAK BİR MUDDET BEKLENECEK (SYSTICK TIMER KULLANABILIRIZ)
	 * 6. UCUNCU KUVETE GIDECEK KAPASITIF SENSOR KONTROL EDECEK(EGER KUVET YOKSA MOTORU DURDURUP ESKI YERINE DÖNECEK.) VE DALDIRACAK CIKARACAK VE BEKLEYECEK.
	 * 7. BURADA TIMER AYARLANARAK BİR MUDDET BEKLENECEK (SYSTICK TIMER KULLANABILIRIZ) (BURADA POMPA MOTORU DISTILE SUYU KÜVETE DOLDURMALI)
	 * 8. DORDUNCU KUVETE GIDECEK KAPASITIF SENSOR KONTROL EDECEK(EGER KUVET YOKSA MOTORU DURDURUP ESKI YERINE DÖNECEK.) VE DALDIRACAK CIKARACAK VE BEKLEYECEK.
	 * 9. BURADA TIMER AYARLANARAK BİR MUDDET BEKLENECEK (SYSTICK TIMER KULLANABILIRIZ) (SYSTICK TIMER INTERRUPT ICINDE ÇALISMAYABILIR DIKKAT.)
	 * 10. ISLEMLER BİTİNCE KURUTMAYA GİDECEK
	 * 11. KURUTMA İSLEMINDEN SONRA POMPA MOTORU ATIK SU YU ÇEKECEK BOSALTACAK.
	 * 12. ISLEM BİTER VE ELEKTROMIKNATIS KAPAGI SALABİLİR. (BU ISLEMLER BİTMEDEN KAPAGI AÇMAYA IZIN VERMEYECEK.)
	 */

	switch(Process_Number)
	{
		case 1: // RAK'I ALMAYA GIDECEK VE ALACAK. RAK'I ALIRKEN DIREKT OLARAK Z EKSENINDE ASAGIYA INMEYECEK. HASSAS HAREKETLER VAR. HALIL ILE BIRLIKTE CIHAZ ORTAYA CIKINCA BELLI OLACAK.
		{

			delay_ms(1500);  //  IKI MOTOR ARASI HAREKET ASIRI HIZLI OLURSA SORUN TESKIL EDEBILIR BIR MIKTAR GECIKME VEREREK HAREKET ETTIRIYORUZ.
			GotoTetaMotorPosition(RAK_TETAAXIS_POSITION,DUTYCYCLE_75);
			delay_ms(1500);  // IKI MOTOR ARASI HAREKET ASIRI HIZLI OLURSA SORUN TESKIL EDEBILIR BIR MIKTAR GECIKME VEREREK HAREKET ETTIRIYORUZ.
			GotoZMotorPosition(RAK_ZAXIS_POSITION,DUTYCYCLE_75);
			delay_ms(1500);  // IKI MOTOR ARASI HAREKET ASIRI HIZLI OLURSA SORUN TESKIL EDEBILIR BIR MIKTAR GECIKME VEREREK HAREKET ETTIRIYORUZ. BU DELAY DEGERI DEGISEBILIR. AYRICA BU DELAY SYSTICK TIMER ILE YAPILDI.
			GotoZMotorPosition(MOTORMAXPOSITION_ZAXIS,DUTYCYCLE_75);
			delay_ms(1500);  //  IKI MOTOR ARASI HAREKET ASIRI HIZLI OLURSA SORUN TESKIL EDEBILIR BIR MIKTAR GECIKME VEREREK HAREKET ETTIRIYORUZ.
			PERCENT_BEGINNING_AND_GETCURRENT_ICON[7] +=25;
			delay_ms(10);

			HAL_UART_Transmit_IT(&huart2, PERCENT_BEGINNING_AND_GETCURRENT_ICON, 8);
			delay_ms(50);

			break;
		}

		case 2: // BIRINCI KUVETE GIDECEK KAPASITIF SENSOR KONTROL EDECEK (BURADA TIMER AYARLANARAK BİR MUDDET BEKLENECEK). BU KISIMDA KUVETIN KAPAGINI ACMAK ICIN BAZI HAREKETLER GEREKECEK.
		{
			HAL_UART_Transmit_IT(&huart2, PROCESS_FIRST_STAINER_TUB, 8);

			delay_ms(50);
			GotoTetaMotorPosition(BIRINCIKUVET_TETAAXIS_POSITION,DUTYCYCLE_75);
			ZAxis_MotorPositionGecici = ZAxis_MotorPosition;

			delay_ms(1500);  // IKI MOTOR ARASI HAREKET ASIRI HIZLI OLURSA SORUN TESKIL EDEBILIR BIR MIKTAR GECIKME VEREREK HAREKET ETTIRIYORUZ.

			if(!(HAL_GPIO_ReadPin(KAPASITIFSENSORKONTROL_GPIO_Port, KAPASITIFSENSORKONTROL_Pin) == GPIO_PIN_RESET || ZAxis_MotorPosition == MOTORMINPOSITION_ZAXIS))
			{
				while(!(HAL_GPIO_ReadPin(KAPASITIFSENSORKONTROL_GPIO_Port, KAPASITIFSENSORKONTROL_Pin) == GPIO_PIN_RESET || ZAxis_MotorPosition == MOTORMINPOSITION_ZAXIS)) // Z AXIS KAPASİTİF SENSÖR LE KONTROL EDECEK. // BU KISIMDA KUCUK ARALIKLARLA STEP MOTORU DONDEREREK BIR DEGISKEN UZERINDEN DEGER ALACAGIZ. BU DEGER KAPASITIF SENSORUN SIVIYI ALGILADIGI YER OLACAK. DAHA SONRA  BU DEGISKEN KUVET_HALFUP A ATANACAK. AYRICA EGER KI KAPASITIF SENSORU GORMEZSE Z EKSENININ MINIMUMA GELEREK DURMASI LAZIM.
				{
					ZAxis_MotorPositionGecici -=30;
					GotoZMotorPosition(ZAxis_MotorPositionGecici,DUTYCYCLE_25); // ONCE 1 AZALTIYOR SONRA ATIYOR VE BU SEKILDE ASAGIYA DOGRU INIYOR.(DOGRU CALISIYOR MU KONTROL EDILECEK)
					//	GotoZMotorPosition(KUVETE_DALDIRMA_BOYU_ZAXIS,74); // BURDA KUVETE DALDIRMA BOYUNA DEGER ATAMASI YAPILACAK. BUNUN ICIN HALIL ILE BIRLIKTE ADIM SAYISI, POZISYON AYARI YAPILACAK.
					//	KUVETE_DALDIRMA_BOYU_ZAXIS = ZAxis_MotorPosition;  // BU KISIMDAN EMİN DEGİLİM DENEME YAPMAK GEREKİYOR. STEP MOTOR ADIM SAYISI ILE BURDA KONUM BILGISI ALINMASI GEREKIYOR.

				}
			}




			if(ZAxis_MotorPosition <= 0 ) // BURASI DEGISECEK GECICI OLARAK YAZILDI. EGER ZAxisMotorposition 0 a INMISSE KUVET YOKTUR YADA KUVEETTE SIVI YOKTUR UYARI VERILECEK.
			{
				KUVETE_DALDIRMA_BOYU_ZAXIS = 700;  // BURASI DEGISECEK GECICI OLARAK YAZILDI. ONCEDEN BURAYA 0 ATAMISTIK. 670. SATIR SORUN TESKIL ETTIGI ICIN GECICI OLARAK 30 YAZDIK.
			}

			delay_ms(1500);  // IKI MOTOR ARASI HAREKET ASIRI HIZLI OLURSA SORUN TESKIL EDEBILIR BIR MIKTAR GECIKME VEREREK HAREKET ETTIRIYORUZ.

			for(Loop=0;Loop<4;Loop++) // LOOP 4 MU OLACAK?
			{
					GotoZMotorPosition(KUVETE_DALDIRMA_BOYU_ZAXIS - LAM_HEIGHT,DUTYCYCLE_75); // BU KISIMDA KUVETEDALDIRMABOYU - BIR LAM BOYU OLARAK AYARLAYACAGIZ.
					delay_ms(1000); // BU DELAY DEGERI DEGISEBILIR.
					GotoZMotorPosition(KUVETE_DALDIRMA_BOYU_ZAXIS + LAM_HEIGHT,DUTYCYCLE_75);  // KUVET HALFUP KAPASITIF SENSOR ILE AYARLANDIKTAN SONRA BU NOKTAYA KUVETEDALDIRMABOYU + BIR LAM BOYU  KADAR YUKARI CIKMASI SAGLANMALI.
					delay_ms(300); // BU SATIRA DELAY EKLENECEK. DelayMs(200);

			}
			delay_ms(1000*60*10);  // BURADA GERCEK BEKLEME ISLEMINI YAPACAK BU GECICI OLARAK YAZILDI. IKI MOTOR ARASI HAREKET ASIRI HIZLI OLURSA SORUN TESKIL EDEBILIR BIR MIKTAR GECIKME VEREREK HAREKET ETTIRIYORUZ.
			// BU KISIMDA DALMA VE CIKARTMA ISLEMI YAPILACAK (AYRICA BEKLEME ISLEMI YAPILACAK.)
			GotoZMotorPosition(MOTORMAXPOSITION_ZAXIS,DUTYCYCLE_75); // ISLEM BITINCE EN YUKSEK Z KONUMUNA GIDIYOR.
			delay_ms(1500);  //  IKI MOTOR ARASI HAREKET ASIRI HIZLI OLURSA SORUN TESKIL EDEBILIR BIR MIKTAR GECIKME VEREREK HAREKET ETTIRIYORUZ.

			PERCENT_BEGINNING_AND_GETCURRENT_ICON[7] +=25;
			delay_ms(50);

			HAL_UART_Transmit_IT(&huart2, PERCENT_BEGINNING_AND_GETCURRENT_ICON, 8);
			delay_ms(60);

			break;
		}

		case 3: // IKINCI KUVETE GIDECEK KAPASITIF SENSOR KONTROL EDECEK (BURADA TIMER AYARLANARAK BİR MUDDET BEKLENECEK).BU KISIMDA KUVETIN KAPAGINI ACMAK ICIN BAZI HAREKETLER GEREKECEK.
		{
			HAL_UART_Transmit_IT(&huart2, PROCESS_SECOND_STAINER_TUB, 8);

			delay_ms(50);
			GotoTetaMotorPosition(IKINCIKUVET_TETAAXIS_POSITION,DUTYCYCLE_75);

			delay_ms(1500);  //  IKI MOTOR ARASI HAREKET ASIRI HIZLI OLURSA SORUN TESKIL EDEBILIR BIR MIKTAR GECIKME VEREREK HAREKET ETTIRIYORUZ.

			if(!(HAL_GPIO_ReadPin(KAPASITIFSENSORKONTROL_GPIO_Port, KAPASITIFSENSORKONTROL_Pin) == GPIO_PIN_RESET || ZAxis_MotorPosition == MOTORMINPOSITION_ZAXIS))
			{
				while(!(HAL_GPIO_ReadPin(KAPASITIFSENSORKONTROL_GPIO_Port, KAPASITIFSENSORKONTROL_Pin) == GPIO_PIN_RESET || ZAxis_MotorPosition == MOTORMINPOSITION_ZAXIS)) // Z AXIS KAPASİTİF SENSÖR LE KONTROL EDECEK. // BU KISIMDA KUCUK ARALIKLARLA STEP MOTORU DONDEREREK BIR DEGISKEN UZERINDEN DEGER ALACAGIZ. BU DEGER KAPASITIF SENSORUN SIVIYI ALGILADIGI YER OLACAK. DAHA SONRA  BU DEGISKEN KUVET_HALFUP A ATANACAK. AYRICA EGER KI KAPASITIF SENSORU GORMEZSE Z EKSENININ MINIMUMA GELEREK DURMASI LAZIM.
				{
					ZAxis_MotorPositionGecici -=30;
					GotoZMotorPosition(ZAxis_MotorPositionGecici,DUTYCYCLE_25); // ONCE 1 AZALTIYOR SONRA ATIYOR VE BU SEKILDE ASAGIYA DOGRU INIYOR.(DOGRU CALISIYOR MU KONTROL EDILECEK)
					//	GotoZMotorPosition(KUVETE_DALDIRMA_BOYU_ZAXIS,74); // BURDA KUVETE DALDIRMA BOYUNA DEGER ATAMASI YAPILACAK. BUNUN ICIN HALIL ILE BIRLIKTE ADIM SAYISI, POZISYON AYARI YAPILACAK.
					//	KUVETE_DALDIRMA_BOYU_ZAXIS = ZAxis_MotorPosition;  // BU KISIMDAN EMİN DEGİLİM DENEME YAPMAK GEREKİYOR. STEP MOTOR ADIM SAYISI ILE BURDA KONUM BILGISI ALINMASI GEREKIYOR.

				}
			}




			if(ZAxis_MotorPosition <= 0 ) // BURASI DEGISECEK GECICI OLARAK YAZILDI. EGER ZAxisMotorposition 0 a INMISSE KUVET YOKTUR YADA KUVEETTE SIVI YOKTUR UYARI VERILECEK.
			{
				KUVETE_DALDIRMA_BOYU_ZAXIS = 700;  // BURASI DEGISECEK GECICI OLARAK YAZILDI. ONCEDEN BURAYA 0 ATAMISTIK. 670. SATIR SORUN TESKIL ETTIGI ICIN GECICI OLARAK 30 YAZDIK.
			}
			delay_ms(1500);  // IKI MOTOR ARASI HAREKET ASIRI HIZLI OLURSA SORUN TESKIL EDEBILIR BIR MIKTAR GECIKME VEREREK HAREKET ETTIRIYORUZ.

			for(Loop=0;Loop<4;Loop++) // LOOP 4 MU OLACAK?
			{
				GotoZMotorPosition(KUVETE_DALDIRMA_BOYU_ZAXIS - LAM_HEIGHT,DUTYCYCLE_75); // BU KISIMDA KUVETEDALDIRMABOYU - BIR LAM BOYU OLARAK AYARLAYACAGIZ.
				delay_ms(1000); // BU DELAY DEGERI DEGISEBILIR.
				GotoZMotorPosition(KUVETE_DALDIRMA_BOYU_ZAXIS + LAM_HEIGHT,DUTYCYCLE_75);  // KUVET HALFUP KAPASITIF SENSOR ILE AYARLANDIKTAN SONRA BU NOKTAYA KUVETEDALDIRMABOYU + BIR LAM BOYU  KADAR YUKARI CIKMASI SAGLANMALI.
				delay_ms(300); // BU SATIRA DELAY EKLENECEK. DelayMs(200);

			}
			delay_ms(1000*60*10);  // BURADA GERCEK BEKLEME ISLEMINI YAPACAK BU GECICI OLARAK YAZILDI. IKI MOTOR ARASI HAREKET ASIRI HIZLI OLURSA SORUN TESKIL EDEBILIR BIR MIKTAR GECIKME VEREREK HAREKET ETTIRIYORUZ.
			// BU KISIMDA DALMA VE CIKARTMA ISLEMI YAPILACAK (AYRICA BEKLEME ISLEMI YAPILACAK.)
			GotoZMotorPosition(MOTORMAXPOSITION_ZAXIS,DUTYCYCLE_75); // ISLEM BITINCE EN YUKSEK Z KONUMUNA GIDIYOR.
			delay_ms(1500);  //  IKI MOTOR ARASI HAREKET ASIRI HIZLI OLURSA SORUN TESKIL EDEBILIR BIR MIKTAR GECIKME VEREREK HAREKET ETTIRIYORUZ.

			PERCENT_BEGINNING_AND_GETCURRENT_ICON[7] +=25;
			delay_ms(50);

			HAL_UART_Transmit_IT(&huart2, PERCENT_BEGINNING_AND_GETCURRENT_ICON, 8);
			delay_ms(50);

			break;
		}

		case 4: // UCUNCU KUVETE GIDECEK KAPASITIF SENSOR KONTROL EDECEK (BURADA TIMER AYARLANARAK BİR MUDDET BEKLENECEK). BU KISIMDA KUVETIN KAPAGINI ACMAK ICIN BAZI HAREKETLER GEREKECEK.
		{  // (BURADA POMPA MOTORU DISTILE SUYU KÜVETE DOLDURMALI)
			HAL_UART_Transmit_IT(&huart2, PROCESS_THIRD_STAINER_TUB_BUFFER, 8);

			delay_ms(50);
			GotoTetaMotorPosition(UCUNCUKUVET_TETAAXIS_POSITION,DUTYCYCLE_75);

			delay_ms(1500);  //  IKI MOTOR ARASI HAREKET ASIRI HIZLI OLURSA SORUN TESKIL EDEBILIR BIR MIKTAR GECIKME VEREREK HAREKET ETTIRIYORUZ.

			if(!(HAL_GPIO_ReadPin(KAPASITIFSENSORKONTROL_GPIO_Port, KAPASITIFSENSORKONTROL_Pin) == GPIO_PIN_RESET || ZAxis_MotorPosition == MOTORMINPOSITION_ZAXIS))
			{
				while(!(HAL_GPIO_ReadPin(KAPASITIFSENSORKONTROL_GPIO_Port, KAPASITIFSENSORKONTROL_Pin) == GPIO_PIN_RESET || ZAxis_MotorPosition == MOTORMINPOSITION_ZAXIS)) // Z AXIS KAPASİTİF SENSÖR LE KONTROL EDECEK. // BU KISIMDA KUCUK ARALIKLARLA STEP MOTORU DONDEREREK BIR DEGISKEN UZERINDEN DEGER ALACAGIZ. BU DEGER KAPASITIF SENSORUN SIVIYI ALGILADIGI YER OLACAK. DAHA SONRA  BU DEGISKEN KUVET_HALFUP A ATANACAK. AYRICA EGER KI KAPASITIF SENSORU GORMEZSE Z EKSENININ MINIMUMA GELEREK DURMASI LAZIM.
				{
					ZAxis_MotorPositionGecici -=30;
					GotoZMotorPosition(ZAxis_MotorPositionGecici,DUTYCYCLE_25); // ONCE 1 AZALTIYOR SONRA ATIYOR VE BU SEKILDE ASAGIYA DOGRU INIYOR.(DOGRU CALISIYOR MU KONTROL EDILECEK)
					//	GotoZMotorPosition(KUVETE_DALDIRMA_BOYU_ZAXIS,74); // BURDA KUVETE DALDIRMA BOYUNA DEGER ATAMASI YAPILACAK. BUNUN ICIN HALIL ILE BIRLIKTE ADIM SAYISI, POZISYON AYARI YAPILACAK.
					//	KUVETE_DALDIRMA_BOYU_ZAXIS = ZAxis_MotorPosition;  // BU KISIMDAN EMİN DEGİLİM DENEME YAPMAK GEREKİYOR. STEP MOTOR ADIM SAYISI ILE BURDA KONUM BILGISI ALINMASI GEREKIYOR.

				}
			}




			if(ZAxis_MotorPosition <= 0 ) // BURASI DEGISECEK GECICI OLARAK YAZILDI. EGER ZAxisMotorposition 0 a INMISSE KUVET YOKTUR YADA KUVEETTE SIVI YOKTUR UYARI VERILECEK.
			{
				KUVETE_DALDIRMA_BOYU_ZAXIS = 700;  // BURASI DEGISECEK GECICI OLARAK YAZILDI. ONCEDEN BURAYA 0 ATAMISTIK. 670. SATIR SORUN TESKIL ETTIGI ICIN GECICI OLARAK 30 YAZDIK.
			}
			delay_ms(1500);  // IKI MOTOR ARASI HAREKET ASIRI HIZLI OLURSA SORUN TESKIL EDEBILIR BIR MIKTAR GECIKME VEREREK HAREKET ETTIRIYORUZ.

			for(Loop=0;Loop<4;Loop++) // LOOP 4 MU OLACAK?
			{
				GotoZMotorPosition(KUVETE_DALDIRMA_BOYU_ZAXIS - LAM_HEIGHT,DUTYCYCLE_75); // BU KISIMDA KUVETEDALDIRMABOYU - BIR LAM BOYU OLARAK AYARLAYACAGIZ.
				delay_ms(1000); // BU DELAY DEGERI DEGISEBILIR.
				GotoZMotorPosition(KUVETE_DALDIRMA_BOYU_ZAXIS + LAM_HEIGHT,DUTYCYCLE_75);  // KUVET HALFUP KAPASITIF SENSOR ILE AYARLANDIKTAN SONRA BU NOKTAYA KUVETEDALDIRMABOYU + BIR LAM BOYU  KADAR YUKARI CIKMASI SAGLANMALI.
				delay_ms(300); // BU SATIRA DELAY EKLENECEK. DelayMs(200);

			}
			// BU KISIMDA DALMA VE CIKARTMA ISLEMI YAPILACAK (AYRICA BEKLEME(YAKLASIK 8 dk) ISLEMI YAPILACAK.)

			delay_ms(1000*60*10);  // BURADA GERCEK BEKLEME ISLEMINI YAPACAK BU GECICI OLARAK YAZILDI. IKI MOTOR ARASI HAREKET ASIRI HIZLI OLURSA SORUN TESKIL EDEBILIR BIR MIKTAR GECIKME VEREREK HAREKET ETTIRIYORUZ.
			/*
			 * BURDA  DC MOTOR CALISTIRMAK ICIN SURE AYARI YAPILACAK. NE ZAMAN ÇALISSIN. (8. DK BITINCE )
			 */


			/*
			 * -- DC MOTOR DOLUM POMPASI DURUMLARI--
			 * 1. GotoZMotorPosition(MOTORMAXPOSITION_ZAXIS); KOMUTUNUN SURESINE GORE KENDISINDEN ONCE DOLUMA BASLAYIP KENDISINDEN HEMEN SONRA BITIRECEGIZ. BASLAMA ILE DC MOTORU ENABLE EDECEGİZ. BITINCE DISABLE EDECEGIZ. BOSALTIM POMPASI KENDISI ENABLE EDECEK.
			 * 2. GotoZMotorPosition(MOTORMAXPOSITION_ZAXIS); KOMUTUNUN SURESI YETERLI GELMEZSE GotoZMotorPosition(MOTORMAXPOSITION_ZAXIS); KOMUTUNDAN ONCE BASLAYIP case 5: DE GotoTetaMotorPosition(DORDUNCUKUVET_TETAAXIS_POSITION); KOMUTUNDAN HEMEN ONCE BITIRECEGIZ.
			 * 3. GotoZMotorPosition(MOTORMAXPOSITION_ZAXIS); KOMUTUNUN SURESI YETERLI GELMEZSE GotoZMotorPosition(MOTORMAXPOSITION_ZAXIS); KOMUTUNDAN ONCE BASLAYIP case 5: DE GotoTetaMotorPosition(DORDUNCUKUVET_TETAAXIS_POSITION); KOMUTUNDAN HEMEN SONRA BITIRECEGIZ.
			 * 4. ISLEMLER BITTIKTEN SONRADA BORULARIN TEMIZLENMESI SAGLANACAK(?)
			 *
			 */

			GotoZMotorPosition(MOTORMAXPOSITION_ZAXIS,DUTYCYCLE_75); // ISLEM BITINCE EN YUKSEK Z KONUMUNA GIDIYOR. BURAYA KAC SANIYEDE CIKACAK. CUNKU DOLUM POMPASINI ONA GORE DURDURACAGIZ.
			delay_ms(1500);  //  IKI MOTOR ARASI HAREKET ASIRI HIZLI OLURSA SORUN TESKIL EDEBILIR BIR MIKTAR GECIKME VEREREK HAREKET ETTIRIYORUZ.

			PERCENT_BEGINNING_AND_GETCURRENT_ICON[7] +=10;
			delay_ms(50);

			HAL_UART_Transmit_IT(&huart2, PERCENT_BEGINNING_AND_GETCURRENT_ICON, 8);
			delay_ms(50);
			break;
		}

		case 5: // DORDUNCU KUVETE GIDECEK KAPASITIF SENSOR KONTROL EDECEK (BURADA TIMER AYARLANARAK BİR MUDDET BEKLENECEK).BU KISIMDA KUVETIN KAPAGINI ACMAK ICIN BAZI HAREKETLER GEREKECEK.
		{
			HAL_UART_Transmit_IT(&huart2, PROCESS_FOURTH_STAINER_TUB_RINSING, 8);

			delay_ms(50);
			GotoTetaMotorPosition(DORDUNCUKUVET_TETAAXIS_POSITION,DUTYCYCLE_75);
			delay_ms(1500);  //  IKI MOTOR ARASI HAREKET ASIRI HIZLI OLURSA SORUN TESKIL EDEBILIR BIR MIKTAR GECIKME VEREREK HAREKET ETTIRIYORUZ.

			if(!(HAL_GPIO_ReadPin(KAPASITIFSENSORKONTROL_GPIO_Port, KAPASITIFSENSORKONTROL_Pin) == GPIO_PIN_RESET || ZAxis_MotorPosition == MOTORMINPOSITION_ZAXIS))
			{
				while(!(HAL_GPIO_ReadPin(KAPASITIFSENSORKONTROL_GPIO_Port, KAPASITIFSENSORKONTROL_Pin) == GPIO_PIN_RESET || ZAxis_MotorPosition == MOTORMINPOSITION_ZAXIS)) // Z AXIS KAPASİTİF SENSÖR LE KONTROL EDECEK. // BU KISIMDA KUCUK ARALIKLARLA STEP MOTORU DONDEREREK BIR DEGISKEN UZERINDEN DEGER ALACAGIZ. BU DEGER KAPASITIF SENSORUN SIVIYI ALGILADIGI YER OLACAK. DAHA SONRA  BU DEGISKEN KUVET_HALFUP A ATANACAK. AYRICA EGER KI KAPASITIF SENSORU GORMEZSE Z EKSENININ MINIMUMA GELEREK DURMASI LAZIM.
				{
					ZAxis_MotorPositionGecici -=30;
					GotoZMotorPosition(ZAxis_MotorPositionGecici,DUTYCYCLE_25); // ONCE 1 AZALTIYOR SONRA ATIYOR VE BU SEKILDE ASAGIYA DOGRU INIYOR.(DOGRU CALISIYOR MU KONTROL EDILECEK)
					//	GotoZMotorPosition(KUVETE_DALDIRMA_BOYU_ZAXIS,74); // BURDA KUVETE DALDIRMA BOYUNA DEGER ATAMASI YAPILACAK. BUNUN ICIN HALIL ILE BIRLIKTE ADIM SAYISI, POZISYON AYARI YAPILACAK.
					//	KUVETE_DALDIRMA_BOYU_ZAXIS = ZAxis_MotorPosition;  // BU KISIMDAN EMİN DEGİLİM DENEME YAPMAK GEREKİYOR. STEP MOTOR ADIM SAYISI ILE BURDA KONUM BILGISI ALINMASI GEREKIYOR.

				}
			}




			if(ZAxis_MotorPosition <= 0 ) // BURASI DEGISECEK GECICI OLARAK YAZILDI. EGER ZAxisMotorposition 0 a INMISSE KUVET YOKTUR YADA KUVEETTE SIVI YOKTUR UYARI VERILECEK.
			{
				KUVETE_DALDIRMA_BOYU_ZAXIS = 700;  // BURASI DEGISECEK GECICI OLARAK YAZILDI. ONCEDEN BURAYA 0 ATAMISTIK. 670. SATIR SORUN TESKIL ETTIGI ICIN GECICI OLARAK 30 YAZDIK.
			}
			delay_ms(1500);  // IKI MOTOR ARASI HAREKET ASIRI HIZLI OLURSA SORUN TESKIL EDEBILIR BIR MIKTAR GECIKME VEREREK HAREKET ETTIRIYORUZ.

			for(Loop=0;Loop<4;Loop++) // LOOP 4 MU OLACAK?
			{
				GotoZMotorPosition(KUVETE_DALDIRMA_BOYU_ZAXIS - LAM_HEIGHT,DUTYCYCLE_75); // BU KISIMDA KUVETEDALDIRMABOYU - BIR LAM BOYU OLARAK AYARLAYACAGIZ.
				delay_ms(1000); // BU DELAY DEGERI DEGISEBILIR.
				GotoZMotorPosition(KUVETE_DALDIRMA_BOYU_ZAXIS + LAM_HEIGHT,DUTYCYCLE_75);  // KUVET HALFUP KAPASITIF SENSOR ILE AYARLANDIKTAN SONRA BU NOKTAYA KUVETEDALDIRMABOYU + BIR LAM BOYU  KADAR YUKARI CIKMASI SAGLANMALI.
				delay_ms(300); // BU SATIRA DELAY EKLENECEK. DelayMs(200);

			}
			// BU KISIMDA DALMA VE CIKARTMA ISLEMI YAPILACAK (AYRICA BEKLEME ISLEMI YAPILACAK.)
			delay_ms(1000*60*10);  // BURDA GERCEK BEKLEME ISLEMINI YAPACAK. IKI MOTOR ARASI HAREKET ASIRI HIZLI OLURSA SORUN TESKIL EDEBILIR BIR MIKTAR GECIKME VEREREK HAREKET ETTIRIYORUZ.
			GotoZMotorPosition(MOTORMAXPOSITION_ZAXIS,DUTYCYCLE_75); // ISLEM BITINCE EN YUKSEK Z KONUMUNA GIDIYOR.
			delay_ms(1500);  //  IKI MOTOR ARASI HAREKET ASIRI HIZLI OLURSA SORUN TESKIL EDEBILIR BIR MIKTAR GECIKME VEREREK HAREKET ETTIRIYORUZ.
			/*
			 * -- DC MOTOR BOSALTIM POMPASI DURUMLARI--
			 * 1. case 5: DE GotoZMotorPosition(MOTORMAXPOSITION_ZAXIS); DEN HEMEN SONRA BASLAYIP case 6: DA GotoTetaMotorPosition(RAK_TETAAXIS_POSITION); DAN HEMEN SONRA BITIRMEK. SURUCU BASLARKEN ENABLE , BITERKEN DISABLE EDILECEK.
			 * 2. case 5: DE GotoZMotorPosition(MOTORMAXPOSITION_ZAXIS); DEN HEMEN SONRA BASLAYIP case 6: DA GotoZMotorPosition(RAK_ZAXIS_POSITION); DAN HEMEN SONRA BITIRMEK.
			 * 3. ISLEMLER BITTIKTEN SONRADA BORULARIN TEMIZLENMESI SAGLANACAK(?).
			 *
			 *
			 */

			PERCENT_BEGINNING_AND_GETCURRENT_ICON[7] +=5;
			delay_ms(50);

			HAL_UART_Transmit_IT(&huart2, PERCENT_BEGINNING_AND_GETCURRENT_ICON, 8);
			delay_ms(50);
			break;
		}

		case 6: // KURUTMA ISLEMINE GIDECEK. POMPA MOTORU ATIK SU YU ÇEKECEK BOSALTACAK. (KURUTMA YERİ İLE RAK YERİ AYNI)
		{
			HAL_UART_Transmit_IT(&huart2, PROCESS_FIFTH_STAINER_TUB_DRYING, 8);
			delay_ms(50);
			GotoTetaMotorPosition(RAK_TETAAXIS_POSITION,DUTYCYCLE_75);
			delay_ms(1500);  //  IKI MOTOR ARASI HAREKET ASIRI HIZLI OLURSA SORUN TESKIL EDEBILIR BIR MIKTAR GECIKME VEREREK HAREKET ETTIRIYORUZ.
			GotoZMotorPosition(RAK_ZAXIS_POSITION,DUTYCYCLE_75);
			// BURDA BIR MIKTAR DELAY OLSUN. AYRICA RAK KONULDU MU OLAYINI IR LA INCELEYEBILIRIZ SONRA KARAR VERELIM.
			HAL_GPIO_WritePin(KURUTMAKONTROL_PELTIER_GPIO_Port, KURUTMAKONTROL_PELTIER_Pin, GPIO_PIN_SET); // PELTIER KURUTMA AKTIF
			HAL_GPIO_WritePin(FAN_RAK_GPIO_Port, FAN_RAK_Pin, GPIO_PIN_SET); // FAN RAK KURUTMA AKTIF

			// BU KISMA KURUTMA ICIN OLAN 2 FAN ICINDE KONTROL YAZILIMI EKLENECEK.
			// BURADA BEKLEME ISLEMI YAPILACAK.
			delay_ms(5000);
			HAL_GPIO_WritePin(KURUTMAKONTROL_PELTIER_GPIO_Port, KURUTMAKONTROL_PELTIER_Pin, GPIO_PIN_RESET); // PELTIER KURUTMA KAPATILDI.
			HAL_GPIO_WritePin(FAN_RAK_GPIO_Port, FAN_RAK_Pin, GPIO_PIN_RESET); // FAN RAK KURUTMA KAPATILDI.
			delay_ms(50);
			GotoZMotorPosition(MOTORMAXPOSITION_ZAXIS,DUTYCYCLE_75); // ISLEM BITINCE EN YUKSEK Z KONUMUNA GIDIYOR.

			HAL_TIM_PWM_Start(&htim9, TIM_CHANNEL_2);
			__HAL_TIM_SET_COMPARE(&htim9,TIM_CHANNEL_2,49);




			HAL_GPIO_WritePin(DCMOTOR_ATIK_INA_GPIO_Port, DCMOTOR_ATIK_INA_Pin, GPIO_PIN_SET);
			HAL_GPIO_WritePin(DCMOTOR_ATIK_INB_GPIO_Port, DCMOTOR_ATIK_INB_Pin, GPIO_PIN_RESET);

			delay_ms(4000);

			__HAL_TIM_SET_COMPARE(&htim9,TIM_CHANNEL_2,99);

			delay_ms(7000);
	//		HAL_TIM_PWM_Stop(&htim9, TIM_CHANNEL_1);

			HAL_GPIO_WritePin(DCMOTOR_ATIK_INA_GPIO_Port, DCMOTOR_ATIK_INA_Pin, GPIO_PIN_RESET);
			HAL_GPIO_WritePin(DCMOTOR_ATIK_INB_GPIO_Port, DCMOTOR_ATIK_INB_Pin, GPIO_PIN_RESET);

			HAL_TIM_PWM_Stop(&htim9, TIM_CHANNEL_2);

			delay_ms(1000);

			HAL_TIM_PWM_Start(&htim9, TIM_CHANNEL_1);
			__HAL_TIM_SET_COMPARE(&htim9,TIM_CHANNEL_1,49);

			HAL_GPIO_WritePin(DCMOTOR_DISTILE_INA_GPIO_Port, DCMOTOR_DISTILE_INA_Pin, GPIO_PIN_SET);
			HAL_GPIO_WritePin(DCMOTOR_DISTILE_INB_GPIO_Port, DCMOTOR_DISTILE_INB_Pin, GPIO_PIN_RESET);

			delay_ms(4000);

			__HAL_TIM_SET_COMPARE(&htim9,TIM_CHANNEL_1,99);




			delay_ms(7000);
	//		HAL_TIM_PWM_Stop(&htim9, TIM_CHANNEL_2);

			HAL_GPIO_WritePin(DCMOTOR_DISTILE_INA_GPIO_Port, DCMOTOR_DISTILE_INA_Pin, GPIO_PIN_RESET);
			HAL_GPIO_WritePin(DCMOTOR_DISTILE_INB_GPIO_Port, DCMOTOR_DISTILE_INB_Pin, GPIO_PIN_RESET);

			HAL_TIM_PWM_Stop(&htim9, TIM_CHANNEL_1);

			delay_ms(1000);

		//	i = 1; BURDA CALISTIRIRSAK BASLAMA_BITIS_KONTROLE YENIDEN DONMUYOR DIREKT OLARAK FOR DONGUSUNE DONUYOR.

	/*		HAL_NVIC_EnableIRQ(EXTI3_IRQn);  // YENIDEN INTERRUPTLARI AKTİF ETTİK. SOLCEKMECE,SAGCEKMCE,RAKCEKMECE.
			HAL_NVIC_EnableIRQ(EXTI4_IRQn);
			HAL_NVIC_EnableIRQ(EXTI9_5_IRQn);

			HAL_NVIC_DisableIRQ(EXTI15_10_IRQn);// DISPLEKSI SWITCH . SWITCH KAPALI IKEN GND, SWITCH SERBEST BIRAKILINCA 3.3V VERECEK SEKILDE AYARLANMALI. BURDA DISABLE EDILDI CUNKU KAPAK ACILABILIR BUZZER OTMESINI ISTEMIYORUZ..*/
			HAL_NVIC_DisableIRQ(EXTI15_10_IRQn); // DIS PLEKSI LIMITSWITCH KESMESI ILK BASLAMA ANINDA DISABLE EDILIYOR. CUNKU KAPAK ACILINCA BUZZER CALACAK.
			HAL_NVIC_DisableIRQ(EXTI3_IRQn);    // SAGCEKMECE LIMITSWICTCH KESMESI
			HAL_NVIC_DisableIRQ(EXTI4_IRQn);    // SOLCEKMECE LIMITSWICTCH KESMESI
			HAL_NVIC_DisableIRQ(EXTI9_5_IRQn);   // RAKCEKMECE LIMIT SWITCH KESMESI(PC5)
			Baslama_Bitis_Kontrol = false; // BAYRAGI INDIRDIK. BIRDEN FAZLA KEZ CALISMASI ICIN
			HAL_UART_Transmit_IT(&huart2, POPUP_PROCESS_END_ENGLISH, 6);


			delay_ms(50);

			HAL_UART_Transmit_IT(&huart2, PERCENT_END_ICON, 8);
			delay_ms(50);

			HAL_UART_Transmit_IT(&huart2, ICON_PLAY_BUTTON, 8);

			delay_ms(50);

			for(uint8_t t=0; t<4;t++)
			{
				HAL_UART_Transmit_IT(&huart2, BUZZER, 6);
				delay_ms(500);
			}
			break;
		}
	}
}